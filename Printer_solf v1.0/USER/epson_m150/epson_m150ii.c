#include "epson_m150ii.h"
#include "sys.h"
#include "string.h"
#include "delay.h"

PRINTER_CTR_TYPE p_ctr;

// ----------------- 变量 ------------------- //
uint8_t g_bTimingIntr;	
uint8_t g_bResetIntr;		

const u8 dot_a[] = {1,5, 9,13,17,21,25,29,33,37,41,45,49,53,57,61,65,69,73,77,81,85,89,93,97};
const u8 dot_b[] = {2,6,10,14,18,22,26,30,34,38,42,46,50,54,58,62,66,70,74,78,82,86,90,94,98};
const u8 dot_c[] = {3,7,11,15,19,23,27,31,35,39,43,47,51,55,59,63,67,71,75,79,83,87,91,95,99};
const u8 dot_d[] = {4,8,12,16,20,24,28,32,36,40,44,48,52,56,60,64,68,72,76,80,84,88,92,96,100};

u8 a_i = 0;		// 记录 Head_a 所在位置的变量 
u8 b_i = 0;		// 记录 Head_b 所在位置的变量 
u8 c_i = 0;		// 记录 Head_c 所在位置的变量 
u8 d_i = 0;		// 记录 Head_d 所在位置的变量 

u8 print_real[7][12];		// 最终需要打印缓存的 buffer.
u8 ascii_printer[12][7];	// 需要打印矩阵倒置前的 buffer.
u8 finishi_flag = 0;	// 打印完12 行停电机

// 横向取模
// 这是一个 5x7 的 ASCII 码字库的数组。一共有 96 个可打印的 ASCII码。
unsigned char const ascii_5x7[96][7]={
	0x00,0x00,0x00,0x00,0x00,0x00,0x00,//' ' 	0
	0x04,0x04,0x04,0x04,0x04,0x00,0x04,//'!' 	1
	0x05,0x05,0x05,0x00,0x00,0x00,0x00,//'"' 	2
	0x0A,0x0A,0x1F,0x0A,0x1F,0x0A,0x0A,//'#' 	3
//	0x04,0x1E,0x05,0x0E,0x14,0x0F,0x04,//'$' 	4
	0x11,0x0A,0x1F,0x04,0x1F,0x04,0x04,//'￥'	4	将 '$' 替换为 '￥'
	0x03,0x13,0x08,0x04,0x02,0x19,0x18,//'%' 	5
	0x06,0x09,0x05,0x02,0x15,0x09,0x16,//'&' 	6
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	0x00,0x00,0x00,0x00,0x00,0x00,0x00,//'?' 	95
};

u8 ascii_test[12][7]={
	0xFF,0xFF,0xFF,0xFF,0xFF,0xFF,0xFF,
	0xFF,0xFF,0xFF,0xFF,0xFF,0xFF,0xFF,
	0xFF,0xFF,0xFF,0xFF,0xFF,0xFF,0xFF,
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	0xFF,0xFF,0xFF,0xFF,0xFF,0xFF,0xFF,
/*
	0x55,0xAA,0x55,0xAA,0x55,0xAA,0x55,
	0x55,0xAA,0x55,0xAA,0x55,0xAA,0x55,
	0x55,0xAA,0x55,0xAA,0x55,0xAA,0x55,
	0x55,0xAA,0x55,0xAA,0x55,0xAA,0x55,
	0x55,0xAA,0x55,0xAA,0x55,0xAA,0x55,
	0x55,0xAA,0x55,0xAA,0x55,0xAA,0x55,
	0x55,0xAA,0x55,0xAA,0x55,0xAA,0x55,
	0x55,0xAA,0x55,0xAA,0x55,0xAA,0x55,
	0x55,0xAA,0x55,0xAA,0x55,0xAA,0x55,
	0x55,0xAA,0x55,0xAA,0x55,0xAA,0x55,
	0x55,0xAA,0x55,0xAA,0x55,0xAA,0x55,
	0x55,0xAA,0x55,0xAA,0x55,0xAA,0x55,
*/
};	

// ----------------------- 函数 -------------------------- //
void GPIO_ToggleBit(GPIO_TypeDef* GPIOx, uint16_t GPIO_Pin)
{
	if(GPIO_ReadOutputDataBit(GPIOx, GPIO_Pin) == Bit_SET)
	{
		GPIO_ResetBits(GPIOx, GPIO_Pin);
	}
	else
	{
		GPIO_SetBits(GPIOx, GPIO_Pin);
	}
}

// Printer IO Init
void Printer_IO_Config(void)
{
	GPIO_InitTypeDef    GPIO_InitStructure;
	EXTI_InitTypeDef 	EXTI_InitStructure;	

	RCC_APB2PeriphClockCmd(RCC_APB2Periph_AFIO | RCC_APB2Periph_GPIOB | RCC_APB2Periph_GPIOC , ENABLE);
	
	GPIO_InitStructure.GPIO_Speed = GPIO_Speed_2MHz;	// A 
	GPIO_InitStructure.GPIO_Mode  = GPIO_Mode_Out_PP;
	GPIO_InitStructure.GPIO_Pin =  PTA_PIN;
	GPIO_Init(PTA_PORT, &GPIO_InitStructure);	

	GPIO_InitStructure.GPIO_Speed = GPIO_Speed_2MHz;	// B 
	GPIO_InitStructure.GPIO_Mode  = GPIO_Mode_Out_PP;
	GPIO_InitStructure.GPIO_Pin =  PTB_PIN;
	GPIO_Init(PTB_PORT, &GPIO_InitStructure);	

	GPIO_InitStructure.GPIO_Speed = GPIO_Speed_2MHz;	// C 
	GPIO_InitStructure.GPIO_Mode  = GPIO_Mode_Out_PP;
	GPIO_InitStructure.GPIO_Pin =  PTC_PIN;
	GPIO_Init(PTC_PORT, &GPIO_InitStructure);	

	GPIO_InitStructure.GPIO_Speed = GPIO_Speed_2MHz;	// D 
	GPIO_InitStructure.GPIO_Mode  = GPIO_Mode_Out_PP;
	GPIO_InitStructure.GPIO_Pin =  PTD_PIN;
	GPIO_Init(PTD_PORT, &GPIO_InitStructure);	
	
	GPIO_InitStructure.GPIO_Speed = GPIO_Speed_2MHz;	// 配置 LED1(PB14) 引脚 (不是必须)
	GPIO_InitStructure.GPIO_Mode  = GPIO_Mode_Out_PP;
	GPIO_InitStructure.GPIO_Pin =  GPIO_Pin_14;
	GPIO_Init(GPIOB, &GPIO_InitStructure);
	GPIO_SetBits(GPIOB, GPIO_Pin_14);	// 关闭

	GPIO_InitStructure.GPIO_Speed = GPIO_Speed_2MHz;	// 配置 LED2(PB15) 引脚 (不是必须)
	GPIO_InitStructure.GPIO_Mode  = GPIO_Mode_Out_PP;
	GPIO_InitStructure.GPIO_Pin =  GPIO_Pin_15;
	GPIO_Init(GPIOB, &GPIO_InitStructure);
	GPIO_SetBits(GPIOB, GPIO_Pin_15);	// 关闭

	GPIO_InitStructure.GPIO_Speed = GPIO_Speed_50MHz;			// Motor
	GPIO_InitStructure.GPIO_Mode  = GPIO_Mode_Out_PP;
	GPIO_InitStructure.GPIO_Pin =  MOTER_PIN;
	GPIO_Init(MOTER_PORT, &GPIO_InitStructure);	
	
	/******************  TIMGIMG 外部中断 ******************/
	GPIO_InitStructure.GPIO_Speed = GPIO_Speed_50MHz;			// Timing 
	GPIO_InitStructure.GPIO_Mode  = GPIO_Mode_IN_FLOATING;
	GPIO_InitStructure.GPIO_Pin =  PT_TIMER_PIN;
	GPIO_Init(PT_TIMER_PORT, &GPIO_InitStructure);	

	EXTI_InitStructure.EXTI_Mode = EXTI_Mode_Interrupt;
	EXTI_InitStructure.EXTI_Line = EXTI_Line9;
	EXTI_InitStructure.EXTI_Trigger = EXTI_Trigger_Rising_Falling;		// EXTI_Trigger_Rising_Falling
	EXTI_InitStructure.EXTI_LineCmd = ENABLE;
	EXTI_Init(&EXTI_InitStructure);		
	GPIO_EXTILineConfig(GPIO_PortSourceGPIOB, GPIO_PinSource9);
	EXTI_ClearITPendingBit(EXTI_Line9);		// Clean Timing IT Flag

	/******************  Reset Signal 外部中断 ******************/
	GPIO_InitStructure.GPIO_Speed = GPIO_Speed_50MHz;
	GPIO_InitStructure.GPIO_Mode  = GPIO_Mode_IPU;
	GPIO_InitStructure.GPIO_Pin	 	= PT_RESET_DETCT_PIN;
	GPIO_Init(PT_RESET_DETCT_PORT, &GPIO_InitStructure);	
	
	EXTI_InitStructure.EXTI_Mode = EXTI_Mode_Interrupt;
	EXTI_InitStructure.EXTI_Line = EXTI_Line8;
 	EXTI_InitStructure.EXTI_Trigger = EXTI_Trigger_Falling;		// 下降沿触发	
 	EXTI_InitStructure.EXTI_LineCmd = ENABLE;
	EXTI_Init(&EXTI_InitStructure);
	GPIO_EXTILineConfig(GPIO_PortSourceGPIOB, GPIO_PinSource8);
	EXTI_ClearITPendingBit(EXTI_Line8);		// Clean Timing IT Flag
}

// 打印前初始化
void Printer_Timer_Init(void)
{
	p_ctr.r_h = 0;
	p_ctr.t_h = 0;
	p_ctr.t_num = 0;
}

// 提取相关的数据
/**************************************************
* 函数: void Printer_Font_Extract(char *String)
* 功能: 字符串打印输入
* 参数: String  字符串长度不能大于 12
* 返回值: Null
**************************************************/
void Printer_Font_Extract(char *String)
{
	u8 line_null;
	u8 i,j;
	u8 StringLen = 0x00;
	int x, y;
	StringLen = strlen(String);
	
	// 从字库中取数据填到 buffer 中
	line_null = 12 - StringLen;
	
	for(j = 0; j < StringLen; j++)
	{
		for(i = 0; i < 7; i++)
		{
			ascii_printer[j + line_null][i] = ascii_5x7[*String - 0x20][i];
		}
		String++;
	}	
	
	// 打印点阵 buffer 倒置
	for(x = 0;x < 7; x++)
	{
		for(y = 0;y < 12; y++)
		{
			print_real[x][y] = ascii_printer[y][x];
//			print_real[x][y] = ascii_test[y][x];		// test print ascii 
		}
	}
}

// Print line dot. 
void Printer_line()
{
	u8 space_line = 5;
	
	if(g_bTimingIntr)
	{
		PTA_OFF();
		PTB_OFF();
		PTC_OFF();
		PTD_OFF();
	
		g_bTimingIntr = 0;	// Timing clean.
		p_ctr.t_num ++;
	}
	
	if(g_bResetIntr)	// if receive Reset signal, print line finish, line_number++ 
	{
		g_bResetIntr = 0;	// Reset clean.
		p_ctr.line_num ++;	// printer line finish.

		p_ctr.t_num = 0;		// 记录打印的点清零
		p_ctr.t_num_back = 0; 

		a_i = 0;
		b_i = 0;
		c_i = 0;
		d_i = 0;
	}
	
	if(d_i > 23)	// 打印到最后一个点的时候, 清除针头点的记录
	{
		a_i = 0;
		b_i = 0;
		c_i = 0;
		d_i = 0;
	}
	
	if(p_ctr.line_num > 7 + space_line)	// 打印完成一个点行.	
	{
//		finishi_flag ++;
		MOTER_OFF();
		p_ctr.line_num = 0;
		p_ctr.t_num = 0;
		p_ctr.t_num_back = 0;
		p_ctr.p_on = 0;
		PTA_OFF();
		PTB_OFF();
		PTC_OFF();
		PTD_OFF();
	}
	
//	if(finishi_flag > 3)	// printer 12 line date, stop motor
//	{
//		MOTER_OFF();
//		memset(ascii_printer, 0x00, sizeof(ascii_printer));
//		memset(print_real, 0x00, sizeof(print_real));
//	}
	
	// Judge printer head work logic
	if((p_ctr.t_num < 97) && (p_ctr.t_num != p_ctr.t_num_back) && (p_ctr.line_num > space_line))
	{
		p_ctr.t_num_back = p_ctr.t_num;
		
		/* A */
		if(p_ctr.t_num == dot_a[a_i])
		{
//			if((print_real[p_ctr.line_num-1-space_line][a_i >> 3] & (0x01 << (a_i & 0x07))))
			if((print_real[p_ctr.line_num-1-space_line][a_i/6] & (0x01 << (a_i%6))))	// 比上面这条打印的字模更小, 一行的字最多
			{
				PTA_ON();
//				delay_us(700);
			}else
			{
				PTA_OFF();
			}
			a_i++;
		}

		/* B */
		if(p_ctr.t_num == dot_b[b_i])
		{
//			if((print_real[p_ctr.line_num-1-space_line][(b_i >> 3) + 3] & (0x01 << (b_i & 0x07))))
			if((print_real[p_ctr.line_num-1-space_line][a_i/6] & (0x01 << (a_i%6))))	// 比上面这条打印的字模更小, 一行的字最多
			{
				PTB_ON();
//				delay_us(700);
			}else
			{
				PTB_OFF();
			}
			b_i++;
		}

		/* C */
		if(p_ctr.t_num == dot_c[c_i])
		{
//		if((print_real[p_ctr.line_num-1-space_line][(c_i >> 3) + 6] & (0x01 << (c_i & 0x07))))
		if((print_real[p_ctr.line_num-1-space_line][a_i/6] & (0x01 << (a_i%6))))	// 比上面这条打印的字模更小, 一行的字最多
		{
				PTC_ON();
//				delay_us(600);
			}else
			{
				PTC_OFF();
			}
			c_i++;
		}

		/* D */
		if(p_ctr.t_num == dot_d[d_i])
		{
//			if((print_real[p_ctr.line_num-1-space_line][(d_i >> 3) + 9] & (0x01 << (d_i & 0x07))))			
			if((print_real[p_ctr.line_num-1-space_line][a_i/6] & (0x01 << (a_i%6))))	// 比上面这条打印的字模更小, 一行的字最多
			{
				PTD_ON();
//				delay_us(600);
			}else
			{
				PTD_OFF();
			}
			d_i++;
		}
	}
}


